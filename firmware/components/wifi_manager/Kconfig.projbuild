## firmware/components/wifi_manager/Kconfig.projbuild
```kconfig
menu "Wi-Fi Manager Configuration"

    config WIFI_MANAGER_SSID
        string "Wi-Fi SSID"
        default ""
        help
            Naziv Wi-Fi mreze. Koristi se samo za prvi upis u NVS - posle toga
            uredjaj cita kredencijale iz NVS-a, pa nisu potrebni u firmveru.

    config WIFI_MANAGER_PASSWORD
        string "Wi-Fi Password"
        default ""
        help
            Lozinka Wi-Fi mreze. Koristi se samo za prvi upis u NVS.

    config WIFI_MANAGER_OVERWRITE_NVS
        bool "Prepisi kredencijale u NVS-u vrednostima iz menuconfig-a"
        default n
        help
            Ukljuciti kada treba promeniti mrezu na uredjaju koji vec ima kredencijale u NVS-u.

endmenu
```

## firmware/main/Kconfig.projbuild
```kconfig
menu "CO monitor - uredjaj"

    config DEVICE_ID
        string "ID uredjaja"
        default "radiona1"
        help
            Identifikator uredjaja u MQTT temama: radiona/<id>/co, radiona/<id>/alarm ...

    config MQTT_BROKER_URI
        string "Adresa MQTT brokera"
        default "mqtt://192.168.1.100:1883"
        help
            URI MQTT brokera (Mosquitto iz backend/docker). IP adresa racunara na kom radi broker.

    config MQTT_TOPIC_PREFIX
        string "Prefiks MQTT tema"
        default "radiona"

    config TIMEZONE
        string "Vremenska zona (POSIX TZ)"
        default "CET-1CEST,M3.5.0,M10.5.0/3"

endmenu

menu "CO monitor - pinovi"

    config PIR_GPIO
        int "PIR senzor - GPIO"
        range 0 48
        default 4

    config BUZZER_GPIO
        int "Zujalica - GPIO"
        range 0 48
        default 5

    config BUZZER_ACTIVE_LOW
        bool "Zujalica se ukljucuje na LOW"
        default y
        help
            Modul aktivne zujalice sa vezbi pisti kada je ulaz na LOW.

    config MQ7_ADC_GPIO
        int "MQ-7 AOUT (preko delitelja) - GPIO"
        range 1 10
        default 1
        help
            Mora biti pin ADC1 (GPIO1-GPIO10 na ESP32-S3), jer ADC2 ne radi dok je WiFi ukljucen.

endmenu

menu "CO monitor - MQ-7 senzor"

    config MQ7_WARMUP_S
        int "Zagrevanje posle ukljucenja (s)"
        default 60
        help
            Grejac modula je fabricki vezan na VCC i radi stalno; merenje pocinje
            posle ovog vremena.

    config MQ7_SAMPLE_PERIOD_MS
        int "Period merenja (ms)"
        default 5000

    config MQ7_DIVIDER_RATIO_X1000
        int "Odnos delitelja napona x1000 (Vout/Vadc)"
        default 1500
        help
            AOUT modula ide do 5 V, a ADC podnosi ~3,1 V. Delitelj 10k (gore) / 20k (dole)
            daje Vout = Vadc * 1,5 -> 1500.

    config MQ7_RL_OHM
        int "Otpornik opterecenja RL na modulu (ohm)"
        default 10000
        help
            Na vecini modula je 10k (oznaka 103), na nekima 1k (102). Proveriti na plocici.

    config MQ7_R0_OHM
        int "R0 - otpornost senzora na 100 ppm CO (ohm)"
        default 10000
        help
            Pocetna vrednost dok se senzor ne kalibrise. Cuva se u NVS-u.

endmenu

menu "CO monitor - alarm"

    config CO_ALARM_PPM
        int "Prag alarma (ppm)"
        default 100
        help
            Pocetna vrednost praga. Cuva se u NVS-u i prezivljava restart.

endmenu
```
